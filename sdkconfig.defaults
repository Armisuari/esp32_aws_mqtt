## sdkconfig.defaults
```kconfig
# ESP32-S3 AWS IoT Configuration Defaults

# WiFi Configuration
CONFIG_EXAMPLE_WIFI_SSID=""
CONFIG_EXAMPLE_WIFI_PASSWORD=""
CONFIG_EXAMPLE_WIFI_MAXIMUM_RETRY=5

# AWS IoT Configuration  
CONFIG_AWS_IOT_MQTT_HOST="your-endpoint.iot.region.amazonaws.com"
CONFIG_AWS_IOT_MQTT_PORT=8883
CONFIG_AWS_IOT_DEVICE_THING_NAME="esp32-s3-device"
CONFIG_AWS_IOT_ROOT_CA_FILENAME="aws_root_ca.pem"
CONFIG_AWS_IOT_CERTIFICATE_FILENAME="device_cert.pem"
CONFIG_AWS_IOT_PRIVATE_KEY_FILENAME="device_private_key.pem"

# MQTT Configuration
CONFIG_AWS_IOT_MQTT_TX_BUF_LEN=512
CONFIG_AWS_IOT_MQTT_RX_BUF_LEN=1024

# Logging Configuration
CONFIG_LOG_DEFAULT_LEVEL_INFO=y
CONFIG_LOG_DEFAULT_LEVEL=3

# ESP32-S3 Specific
CONFIG_IDF_TARGET="esp32s3"
CONFIG_IDF_TARGET_ESP32S3=y

# Flash and PSRAM
CONFIG_ESPTOOLPY_FLASHMODE_QIO=y
CONFIG_ESPTOOLPY_FLASHFREQ_80M=y
CONFIG_ESPTOOLPY_FLASHSIZE_4MB=y
CONFIG_SPIRAM_MODE_OCT=y

# FreeRTOS
CONFIG_FREERTOS_HZ=1000
CONFIG_FREERTOS_ASSERT_ON_UNTESTED_FUNCTION=y

# Partition table
CONFIG_PARTITION_TABLE_SINGLE_APP=y

# Component config
CONFIG_ESP_SYSTEM_EVENT_QUEUE_SIZE=32
CONFIG_ESP_SYSTEM_EVENT_TASK_STACK_SIZE=2304
CONFIG_ESP_MAIN_TASK_STACK_SIZE=3584

# TCP/IP Adapter
CONFIG_LWIP_TCP_SND_BUF_DEFAULT=5744
CONFIG_LWIP_TCP_WND_DEFAULT=5744
CONFIG_LWIP_TCP_RECVMBOX_SIZE=6
CONFIG_LWIP_UDP_RECVMBOX_SIZE=6
CONFIG_LWIP_TCPIP_RECVMBOX_SIZE=32

# mbedTLS
CONFIG_MBEDTLS_CERTIFICATE_BUNDLE=y
CONFIG_MBEDTLS_CERTIFICATE_BUNDLE_DEFAULT_FULL=y
```
