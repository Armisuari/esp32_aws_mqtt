## Kconfig.projbuild
```kconfig
menu "AWS IoT Configuration"

    config AWS_IOT_MQTT_HOST
        string "AWS IoT Endpoint"
        default "a26g2r8rrxpe0j-ats.iot.ap-southeast-1.amazonaws.com"
        help
            AWS IoT Core endpoint hostname

    config AWS_IOT_MQTT_PORT
        int "AWS IoT MQTT Port"
        default 8883
        help
            AWS IoT Core MQTT port (usually 8883 for SSL/TLS)

    config AWS_IOT_DEVICE_THING_NAME
        string "AWS IoT Thing Name"
        default "esp32-s3-device"
        help
            AWS IoT Thing name for this device

    menu "SIM7600E Configuration"

        config SIM7600E_APN
            string "APN Name"
            default "internet"
            help
                Access Point Name for cellular data connection

        config SIM7600E_UART_PORT
            int "UART Port"
            default 2
            help
                UART port number for SIM7600E communication

        config SIM7600E_TX_PIN
            int "TX Pin"
            default 2
            help
                GPIO pin for UART TX

        config SIM7600E_RX_PIN
            int "RX Pin"
            default 1
            help
                GPIO pin for UART RX

        config SIM7600E_PWRKEY_PIN
            int "Power Key Pin"
            default 41
            help
                GPIO pin for SIM7600E power key

    endmenu

    menu "Certificate Configuration"

        config AWS_IOT_ROOT_CA_FILENAME
            string "AWS Root CA Filename"
            default "aws_root_ca.pem"
            help
                Root CA certificate filename

        config AWS_IOT_CERTIFICATE_FILENAME
            string "Device Certificate Filename"
            default "device_cert.pem"
            help
                Device certificate filename

        config AWS_IOT_PRIVATE_KEY_FILENAME
            string "Private Key Filename"
            default "device_private_key.pem"
            help
                Device private key filename

    endmenu

endmenu
```
